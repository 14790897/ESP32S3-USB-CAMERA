## sdkconfig.defaults
```kconfig
#
# SPIRAM
#
CONFIG_SPIRAM=y
CONFIG_SPIRAM_MALLOC_RESERVE_INTERNAL=150000
CONFIG_SPIRAM_TRY_ALLOCATE_WIFI_LWIP=y

#
# USB
#
CONFIG_USB_HOST_CONTROL_TRANSFER_MAX_SIZE=3000
CONFIG_USB_HOST_HW_BUFFER_BIAS_IN=y

#
# TinyUSB
#
CONFIG_TINYUSB=y
CONFIG_TINYUSB_VIDEO_ENABLED=y
CONFIG_TINYUSB_VIDEO_STREAMING_INTERFACE=y
CONFIG_TINYUSB_VIDEO_CONTROL_INTERFACE=y
CONFIG_TINYUSB_DESC_USE_ESPRESSIF_VID=y

#
# Camera
#
CONFIG_CAMERA_CORE0_INPUT_DMA=y
CONFIG_CAMERA_DMA_BUFFER_SIZE_MAX=32768

#
# WIFI
#
CONFIG_ESP_WIFI_STATIC_RX_BUFFER_NUM=8
CONFIG_ESP_WIFI_DYNAMIC_RX_BUFFER_NUM=8
CONFIG_ESP_WIFI_STATIC_TX_BUFFER_NUM=8
CONFIG_ESP_WIFI_CACHE_TX_BUFFER_NUM=16
CONFIG_ESP_WIFI_RX_BA_WIN=8

#
# LWIP
#
CONFIG_LWIP_TCP_SND_BUF_DEFAULT=15000

#
# FreeRTOS
#
CONFIG_FREERTOS_HZ=1000

#
# Log
#
CONFIG_LOG_DEFAULT_LEVEL_INFO=y
```

## sdkconfig.defaults.esp32s3
```kconfig
#
# SPIRAM
#
CONFIG_SPIRAM_SPEED_80M=y

#
# SYSTEM
#
CONFIG_ESP_DEFAULT_CPU_FREQ_MHZ_240=y

#
# ESP32S3 specific configuration
#

#
# USB OTG (Device Mode)
#
CONFIG_ESP_USB_OTG_SUPPORTED=y

#
# Camera specific for ESP32S3
#
CONFIG_CAMERA_CORE0_INPUT_DMA=y

#
# PSRAM
#
CONFIG_SPIRAM_MODE_OCT=y
```
